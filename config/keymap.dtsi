

    base {
      bindings = <
                                                                                                                                                   
 &none &kp N1 &kp N2 &kp N3   &kp N4    &kp N5   &none                                      &mo 2     &kp N6 &kp N7 &kp N8   &kp N9  &kp N0  &none 
 &none &kp Q  &kp W  &kp E    &kp R     &kp T    &none                                      &none     &kp Y  &kp U  &kp I    &kp O   &kp P   &none 
 &none &kp A  LC(S)  LS(D)    LG(F)     LA(G)    &none     &none     &none  &none &none     &none     LA(H)  LG(J)  LS(K)    LC(L)   &kp TAB &none 
 &none &none  &kp Z  &kp X    &kp C     SY(1,V)                      &none  &none                     &kp B  &kp N  &kp M    &kp ESC &none   &none 
 &none &none  &none  &kp LEFT &kp RIGHT          &kp BSPC  &kp DEL   &none  &none &kp ENTER &kp SPACE        &kp UP &kp DOWN &none   &none   &none 
                                                                                                                                                   
      >;
    };

mod {
      bindings = <
                                                                                                                                                
 &none       &none &none &none &none &none &none                          &none &kp K_MUTE &kp K_VOL_DN &kp K_VOL_UP &none    &none &none       
 &none       &none &none &none &none &none &none                          &none &kp MINUS  &kp EQUAL    &kp LBKT     &kp RBKT &none &none       
 &none       &none &none &none &none &none &none &none &none  &none &none &none &kp GRAVE  &kp SEMI     &kp SQT      &kp BSLH &none &none       
 &none       &none &none &none &none &none             &none  &none             &kp COMMA  &kp DOT      &kp FSLH     &none    &none &none       
 &bootloader &none &none &none &none       &none &none &none  &none &none &none            &none        &none        &none    &none &bootloader 
                                                                                                                                                
      >;
    };

