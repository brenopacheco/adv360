#define VERSION_MACRO
macro_ver: macro_ver {
compatible = "zmk,behavior-macro";
label = "macro_ver";
#binding-cells = <0>;
bindings = <&kp N2>, <&kp N0>, <&kp N2>, <&kp N4>, <&kp N0>, <&kp N4>, <&kp N1>, <&kp N7>, <&kp MINUS>, <&kp H>, <&kp O>, <&kp M>, <&kp E>, <&kp MINUS>, <&kp C>, <&kp N6>, <&kp N5>, <&kp C>, <&kp E>, <&kp N7>, <&kp N4>, <&kp RET>;
};
